#include <xc.h>
#include "globaldefs.h"
#include "jps_math.h"
#include "atanLUT.h"

void InitSystemClock140(void) 
{
    PLLFBD = 68; // M = 70, PLL Feedback Divisor
    CLKDIVbits.PLLPRE = 2; // N2 = 2, PLL Post-scalar
    CLKDIVbits.PLLPOST = 0; // N1 = 2, PLL Pre-scalar
    OSCTUN = 0;
    // Initiate Clock Switch to Primary Oscillator with PLL (NOSC = 0b011)
    __builtin_write_OSCCONH(0x03);
    __builtin_write_OSCCONL(0x01);
    while(OSCCONbits.COSC != 0b011)
    {
        // Wait for Clock switch to occur
    } 
    while(OSCCONbits.LOCK != 1) 
    {
        // Wait for PLL to lock
    } 
}

void InitSystemClock133(void)
{
    // Configuring PLL change over for 200/3 MIPS
    // This odd cycle frequency optimizes the sampling frequency of ADC1
    // Settings are for use with a 16 MHz external oscillator
    
    PLLFBD = 48; // M = 50, PLL Feedback Divisor
    CLKDIVbits.PLLPRE = 1; // N2 = 1, PLL Post-scalar
    CLKDIVbits.PLLPOST = 0; // N1 = 2, PLL Pre-scalar
    OSCTUN = 0;
    // Initiate Clock Switch to Primary Oscillator with PLL (NOSC = 0b011)
    __builtin_write_OSCCONH(0x03);
    __builtin_write_OSCCONL(0x01);
    while(OSCCONbits.COSC != 0b011)
    {
        // Wait for Clock switch to occur
    } 
    while(OSCCONbits.LOCK != 1) 
    {
        // Wait for PLL to lock
    } 
}

void InitNoTriggerWatchdogTimer(void) 
{
    // TMR45 is a 32-bit timer
    // I'm expecting a pulse with 2 seconds in-between transmissions. If its been 3 seconds and the comparator
    // hasn't triggered, then this 32-bit timer will cause an interrupt and increase the gain by one notch.
    T4CON = 0x8038; // Turn on TMR4
                    // 32-bit mode
                    // P = 256
                    // Use system clock (T_CY)
    PR5 = 0x000B; // Most  significant word of period register
    PR4 = 0xEBC1; // Least significant word of period register
    TMR5 = 0; // Reset 32-bit TMR45 counter value.
    TMR4 = 0; // Reset 32-bit TMR45 counter value.
    // Timer 4 in 32-bit mode uses Timer 5 interrupt services
    _T5IP = 4; // Interrupt priority level
    _T5IF = 0; // Clear interrupt flag
    _T5IE = 1; // Enable TMR4 interrupt source
}

// This timer is used for counting the period between pulses.
void GenPurpTimer32(void) 
{
    T8CON = 0x0008; // Turn on TMR2
                    // 32-bit mode
                    // P = 256
                    // Use system clock (T_CY)
    // T_DELAY = 3 seconds
    // DELAY = 781250 - 1 = 0x000B EBC1
    T8CONbits.TON = 1; //Enable Timer

    TMR8 = 0; // Reset 32-bit TMR8/9 counter value.
    TMR9 = 0; // Reset 32-bit TMR8/9 counter value.
}

// This timer is used to impose the proper delay required to capture leading edge of pulses.
void CaptureFrontTimer(void) 
{
    T6CON = 0x0028; // Turn on TMR6/7
                    // 32-bit mode
                    // P = 1
                    // Use system clock (T_CY)
    T6CONbits.TON = 1; //Enable Timer
    
    PR7 = 0; // Set period register for capturing leading edge of pulse.
    PR6 = 500; // Set period register for capturing leading edge of pulse.
    
    TMR6 = 0; // Reset 32-bit TMR45 counter value.
    TMR7 = 0; // Reset 32-bit TMR45 counter value.
    
    // Timer 6 in 32-bit mode uses Timer 7 interrupt services
    _T7IP = 5; // Interrupt priority level
    _T7IF = 0; // Clear interrupt flag
    _T7IE = 1; // Enable TMR6 interrupt source
}

// This is the comparator trigger configuration
void InitTrigger(void) 
{
    CMSTATbits.PSIDL = 0; // Continues operation of all OPAMPS/CMPS in Idle Mode
    CM4CON = 0x80D0;
    CM4MSKSRC = 0; // Unimplemented
    CM4MSKCON = 0x8000; // The masking (blanking) function will prevent any asserted ('0') comparator signal from propagating
    CM4FLTR = 0; // Digital filter is disabled
    CVR1CON = 0x0880; // Enable CVREF1 circuit
                      // VREF1O is disconnected
                      // Voltage reference is AVDD and AVSS
                      // CVREFIN is generated by an internal resistor network
                      // Comparator voltage reference is [1/3(Vdd-Vss)] (1.1V)
    CVR2CON = 0; // Disable CVREF2 circuit
    _CMIP = 4; // Interrupt priority level
    CM4CONbits.CEN = 1; // Turn on the CMP
    delay_us(40); // Let the CMP stabilize
    CM4CONbits.CEVT = 0; // Clear CMP event status
    _CMIF = 0; // Clear CMP interrupt flag
    _CMIE = 1; // Enable CMP interrupt source
}

//This is the timer that prevents double tirggering within a pulse.
void InitC4TriggerTimer(void)
{
    T1CON = 0x8030;     // enable timer 1, PreScaler of 256
    PR1 = 65535;        // set the period register
    _T1IF = 0;          // set T1 interrupt flag low
    _T1IE = 1;          // enable the T1 interrupt
}
